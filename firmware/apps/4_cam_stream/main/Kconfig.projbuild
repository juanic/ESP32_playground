## firmware/apps/4_cam_stream/main/Kconfig.projbuild
```kconfig
menu "ESP32-CAM stream example"

    config CAM_STREAM_WIFI_SSID
        string "Wi-Fi SSID"
        default "myssid"
        help
            Name of the access point the ESP32-CAM connects to.

    config CAM_STREAM_WIFI_PASSWORD
        string "Wi-Fi password"
        default "mypassword"
        help
            WPA2 password of the access point. Leave empty for open networks.

    choice CAM_STREAM_FRAME_SIZE
        prompt "Frame size"
        default CAM_STREAM_FRAME_SIZE_VGA
        help
            Resolution of the JPEG stream. Larger sizes need more bandwidth
            and PSRAM.

        config CAM_STREAM_FRAME_SIZE_QVGA
            bool "QVGA (320x240)"
        config CAM_STREAM_FRAME_SIZE_VGA
            bool "VGA (640x480)"
        config CAM_STREAM_FRAME_SIZE_SVGA
            bool "SVGA (800x600)"
        config CAM_STREAM_FRAME_SIZE_XGA
            bool "XGA (1024x768)"
    endchoice

    config CAM_STREAM_JPEG_QUALITY
        int "JPEG quality (0-63, lower is better)"
        range 0 63
        default 12

    config CAM_STREAM_FB_COUNT
        int "Number of frame buffers"
        range 1 3
        default 2
        help
            Two buffers usually give a smoother stream. Each VGA JPEG buffer
            takes roughly 32-64 KiB in PSRAM.

endmenu
```

## firmware/apps/5_people_counter/main/Kconfig.projbuild
```kconfig
menu "People counter example"

    config PEOPLE_WIFI_SSID
        string "Wi-Fi SSID"
        default "myssid"
        help
            Name of the access point the ESP32-CAM connects to.

    config PEOPLE_WIFI_PASSWORD
        string "Wi-Fi password"
        default "mypassword"
        help
            WPA2 password of the access point. Leave empty for open networks.

    config PEOPLE_CAPTURE_INTERVAL_S
        int "Capture interval (seconds)"
        range 30 86400
        default 300
        help
            Time between automatic captures. The default is one photo every
            five minutes.

    config PEOPLE_JPEG_QUALITY
        int "JPEG quality (0-63, lower is better)"
        range 4 63
        default 10
        help
            JPEG quality used for the UXGA captures. Higher quality means
            larger files and longer uploads.

    config PEOPLE_FB_COUNT
        int "Number of frame buffers"
        range 1 2
        default 2
        help
            Two buffers in PSRAM avoid frame drops while the previous photo
            is being written to the SD card.

    config PEOPLE_DETECTOR_URL
        string "Detection server URL"
        default "http://192.168.0.70:8080/detect"
        help
            Endpoint that receives the JPEG and answers with the detected
            people. See the server/ folder at the repository root.

    config PEOPLE_CONFIDENCE_PCT
        int "Default confidence threshold (%)"
        range 5 95
        default 50
        help
            Detections below this confidence are ignored. It can be changed
            at runtime from the web UI.

    config PEOPLE_PENDING_RETRY_MAX
        int "Pending detections retried per cycle"
        range 0 10
        default 3
        help
            Maximum number of stored photos whose detection is retried on
            every capture cycle when the detector was unreachable.

    config PEOPLE_HTTP_PORT
        int "HTTP port"
        range 1 65535
        default 80

    config PEOPLE_NTP_SERVER
        string "NTP server"
        default "pool.ntp.org"
        help
            Server used to synchronize the clock. The board needs internet
            access for the file names and the CSV to carry the real date.

    config PEOPLE_TIMEZONE
        string "POSIX timezone"
        default "ART3"
        help
            POSIX TZ string, for example "ART3" for Argentina (UTC-3) or
            "CET-1CEST,M3.5.0,M10.5.0/3" for central Europe.

endmenu
```

## firmware/drivers_hal/Kconfig
```kconfig
menu "HAL drivers"

    config CAMERA_HAL_ENABLED
        bool "Enable camera (DVP) HAL"
        default n
        help
            Compiles the camera HAL and adds the esp32-camera component as a
            dependency. Only enable it in applications that use a DVP camera.

    config WIFI_HAL_ENABLED
        bool "Enable Wi-Fi station HAL"
        default n
        help
            Compiles the Wi-Fi station HAL. Only enable it in applications
            that connect to a wireless network.

    config SD_HAL_ENABLED
        bool "Enable SD card (SDMMC) HAL"
        default n
        help
            Compiles the SD card HAL, which mounts a FAT filesystem on the
            SDMMC host and exposes it through the VFS layer.

endmenu
```

## firmware_S3/drivers_hal/Kconfig
```kconfig
menu "HID Driver (drivers_hal)"

choice HID_TRANSPORT
    prompt "Active HID transport"
    default HID_TRANSPORT_NONE
    help
        Select which HID transport(s) the drivers_hal component builds and
        links. "None" builds only the GPIO/touch HAL (no Bluetooth, no USB HID);
        use it for apps that do not need HID. BLE uses esp_hid (HOGP); USB uses
        TinyUSB. "BLE + USB simultaneously" compiles both so the two transports
        can coexist.

    config HID_TRANSPORT_NONE
        bool "None (no HID)"
    config HID_TRANSPORT_BLE
        bool "BLE (esp_hid / HOGP)"
    config HID_TRANSPORT_USB
        bool "USB (TinyUSB HID)"
    config HID_TRANSPORT_BOTH
        bool "BLE + USB simultaneously"
endchoice

endmenu
```
